/dts-v1/;

#include "UBNT-ER-e50.dtsi"

#include <dt-bindings/gpio/gpio.h>

/ {
	model = "UBNT-ERX-SFP";
	compatible = "ubiquiti,edgerouterx-sfp", "mediatek,mt7621-soc";

};

&i2c {
	status = "okay";
	
	pca9555@25 {
		compatible = "pca9555";
		reg = <0x25>;
	};
};

